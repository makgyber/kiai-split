## zmk/Kconfig.defconfig
```kconfig
# Copyright (c) 2020 The ZMK Contributors
# SPDX-License-Identifier: MIT

if SHIELD_KIAI_RIGHT

config ZMK_KEYBOARD_NAME
	default "KIAI"

config ZMK_SPLIT_BLE_ROLE_CENTRAL
	default y

endif

if SHIELD_KIAI_RIGHT || SHIELD_KIAI_LEFT 

config ZMK_SPLIT
	default y

endif
```

## zmk/Kconfig.shield
```kconfig
# Copyright (c) 2020 The ZMK Contributors
# SPDX-License-Identifier: MIT

config SHIELD_KIAI_LEFT
	def_bool $(shields_list_contains,kiai_left)

config SHIELD_KIAI_RIGHT
	def_bool $(shields_list_contains,kiai_right)
```
